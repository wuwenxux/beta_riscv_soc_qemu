## kernel/beta_defconfig
```kconfig
# Beta SoC QEMU defconfig
# Based on riscv defconfig + Beta hardware requirements

# Core
CONFIG_SMP=y
CONFIG_NR_CPUS=64
CONFIG_HZ_250=y

# Memory
CONFIG_SPARSEMEM=y
CONFIG_SPARSEMEM_VMEMMAP=y
CONFIG_THREAD_SIZE_ORDER=3

# RISC-V ISA extensions (RVA23S64 + V + H)
CONFIG_RISCV_ISA_V=y
CONFIG_RISCV_ISA_V_DEFAULT_ENABLE=y
CONFIG_RISCV_ISA_SVNAPOT=y
CONFIG_RISCV_ISA_SVPBMT=y
CONFIG_RISCV_ISA_ZICBOM=y
CONFIG_RISCV_ISA_ZICBOZ=y
CONFIG_RISCV_ISA_ZAWRS=y

# KVM (H extension)
CONFIG_KVM=y

# AIA (APLIC + IMSIC)
CONFIG_RISCV_APLIC=y
CONFIG_RISCV_IMSIC=y

# PCIe (DWC + RiVAI rv-gen4)
CONFIG_PCI=y
CONFIG_PCI_MSI=y
CONFIG_PCIE_DW=y
CONFIG_PCIE_DW_HOST=y
CONFIG_PCIE_DW_PLAT=y
CONFIG_PCIE_DW_PLAT_HOST=y
CONFIG_PCIE_RV_GEN4=y
CONFIG_PCIE_RV_MGMT=y

# IOMMU
CONFIG_IOMMU_SUPPORT=y
CONFIG_RISCV_IOMMU=y

# Serial
CONFIG_SERIAL_8250=y
CONFIG_SERIAL_8250_CONSOLE=y
CONFIG_SERIAL_OF_PLATFORM=y
CONFIG_SERIAL_EARLYCON=y

# Virtio (for QEMU testing)
CONFIG_VIRTIO=y
CONFIG_VIRTIO_PCI=y
CONFIG_VIRTIO_NET=y
CONFIG_VIRTIO_BLK=y
CONFIG_VIRTIO_CONSOLE=y

# Block devices
CONFIG_BLK_DEV_INITRD=y
CONFIG_BLK_DEV_RAM=y
CONFIG_BLK_DEV_LOOP=y

# Filesystems
CONFIG_EXT4_FS=y
CONFIG_TMPFS=y
CONFIG_PROC_FS=y
CONFIG_SYSFS=y
CONFIG_DEVTMPFS=y
CONFIG_DEVTMPFS_MOUNT=y

# Networking (basic)
CONFIG_NET=y
CONFIG_INET=y
CONFIG_IPV6=y
CONFIG_PACKET=y
CONFIG_UNIX=y

# Device drivers for Ubuntu userspace
CONFIG_TTY=y
CONFIG_VT=y
CONFIG_UNIX98_PTYS=y
CONFIG_INPUT=y
CONFIG_INPUT_EVDEV=y

# Disable FDT raw sysfs (causes oops on some configs)
# CONFIG_OF_FLATTREE is not set

# USB (for future use)
CONFIG_USB_SUPPORT=y
CONFIG_USB=y
CONFIG_USB_XHCI_HCD=y

# Misc
CONFIG_PRINTK=y
CONFIG_PRINTK_TIME=y
CONFIG_MAGIC_SYSRQ=y
CONFIG_MODULES=y
CONFIG_MODULE_UNLOAD=y
```
